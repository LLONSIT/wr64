SECTIONS
{
    __romPos = 0;
    _gp = 0x0;
    header_ROM_START = __romPos;
    header_VRAM = ADDR(.header);
    .header : AT(header_ROM_START) SUBALIGN(16)
    {
        header_DATA_START = .;
        header_s = .;
        build/asm/header.s.o(.data);
        header_DATA_END = .;
        header_DATA_SIZE = ABSOLUTE(header_DATA_END - header_DATA_START);
    }
    __romPos += SIZEOF(.header);
    header_ROM_END = __romPos;
    header_VRAM_END = .;

    boot_ROM_START = __romPos;
    boot_VRAM = ADDR(.boot);
    .boot : AT(boot_ROM_START) SUBALIGN(16)
    {
        boot_DATA_START = .;
        boot_bin = .;
        build/assets/boot.bin.o(.data);
        boot_DATA_END = .;
        boot_DATA_SIZE = ABSOLUTE(boot_DATA_END - boot_DATA_START);
    }
    __romPos += SIZEOF(.boot);
    boot_ROM_END = __romPos;
    boot_VRAM_END = .;

    main_ROM_START = __romPos;
    main_VRAM = ADDR(.main);
    .main 0x80046800 : AT(main_ROM_START) SUBALIGN(16)
    {
        main_TEXT_START = .;
        build/asm/1000.s.o(.text);
        build/src/game_1C70.c.o(.text);
        build/asm/23E0.s.o(.text);
        build/asm/5480.s.o(.text);
        build/src/game_69D0.c.o(.text);
        build/src/game_BD30.c.o(.text);
        build/src/game_BF40.c.o(.text);
        build/src/game_C6C0.c.o(.text);
        build/src/game_24270.c.o(.text);
        build/src/game_24B00.c.o(.text);
        build/asm/2C670.s.o(.text);
        build/asm/34D50.s.o(.text);
        build/asm/355D0.s.o(.text);
        build/asm/39F00.s.o(.text);
        build/asm/3A580.s.o(.text);
        build/asm/3AC00.s.o(.text);
        build/src/game_42670.c.o(.text);
        build/asm/436A0.s.o(.text);
        build/asm/43DA0.s.o(.text);
        build/asm/4C750.s.o(.text);
        build/asm/4F850.s.o(.text);
        build/asm/52990.s.o(.text);
        build/asm/52CD0.s.o(.text);
        build/asm/68A10.s.o(.text);
        build/src/game_6EF50.c.o(.text);
        build/asm/6F530.s.o(.text);
        build/asm/6F5D0.s.o(.text);
        build/asm/71AF0.s.o(.text);
        build/asm/74D80.s.o(.text);
        build/asm/77080.s.o(.text);
        build/asm/79B70.s.o(.text);
        build/src/os/osVirtualtoPhysical.c.o(.text);
        build/src/os/osSendMesg.c.o(.text);
        build/src/os/osGetTime.c.o(.text);
        build/src/os/osSetTime.c.o(.text);
        build/asm/801B0.s.o(.text);
        build/asm/80460.s.o(.text);
        build/asm/805A0.s.o(.text);
        build/asm/visetmode.s.o(.text);
        build/asm/80660.s.o(.text);
        build/asm/80820.s.o(.text);
        build/asm/80B00.s.o(.text);
        build/asm/80B10.s.o(.text);
        build/src/os/osSetEventMesg.c.o(.text);
        build/asm/80BB0.s.o(.text);
        build/src/os/osCreateThread.c.o(.text);
        build/asm/80D70.s.o(.text);
        build/asm/80F70.s.o(.text);
        build/asm/viblack.s.o(.text);
        build/src/setthreadpri.c.o(.text);
        build/asm/815E0.s.o(.text);
        build/asm/sqrtf.s.o(.text);
        build/src/game_81820.c.o(.text);
        build/asm/guOrtho.s.o(.text);
        build/asm/guTranslate.s.o(.text);
        build/asm/81DE0.s.o(.text);
        build/asm/822A0.s.o(.text);
        build/asm/82AD0.s.o(.text);
        build/asm/82C10.s.o(.text);
        build/asm/82D50.s.o(.text);
        build/asm/82DC0.s.o(.text);
        build/asm/830F0.s.o(.text);
        build/asm/83270.s.o(.text);
        build/asm/83410.s.o(.text);
        build/asm/835C0.s.o(.text);
        build/asm/840B0.s.o(.text);
        build/asm/84620.s.o(.text);
        build/asm/84630.s.o(.text);
        build/asm/84760.s.o(.text);
        build/asm/84A10.s.o(.text);
        build/asm/84AC0.s.o(.text);
        build/asm/84B70.s.o(.text);
        build/asm/84C80.s.o(.text);
        main_TEXT_END = .;
        main_TEXT_SIZE = ABSOLUTE(main_TEXT_END - main_TEXT_START);
        main_DATA_START = .;
        _1000_s = .;
        build/asm/1000.s.o(.data);
        game_1C70_c = .;
        build/src/game_1C70.c.o(.data);
        _23E0_s = .;
        build/asm/23E0.s.o(.data);
        _5480_s = .;
        build/asm/5480.s.o(.data);
        game_69D0_c = .;
        build/src/game_69D0.c.o(.data);
        game_BD30_c = .;
        build/src/game_BD30.c.o(.data);
        game_BF40_c = .;
        build/src/game_BF40.c.o(.data);
        game_C6C0_c = .;
        build/src/game_C6C0.c.o(.data);
        game_24270_c = .;
        build/src/game_24270.c.o(.data);
        game_24B00_c = .;
        build/src/game_24B00.c.o(.data);
        _2C670_s = .;
        build/asm/2C670.s.o(.data);
        _34D50_s = .;
        build/asm/34D50.s.o(.data);
        _355D0_s = .;
        build/asm/355D0.s.o(.data);
        _39F00_s = .;
        build/asm/39F00.s.o(.data);
        _3A580_s = .;
        build/asm/3A580.s.o(.data);
        _3AC00_s = .;
        build/asm/3AC00.s.o(.data);
        game_42670_c = .;
        build/src/game_42670.c.o(.data);
        _436A0_s = .;
        build/asm/436A0.s.o(.data);
        _43DA0_s = .;
        build/asm/43DA0.s.o(.data);
        _4C750_s = .;
        build/asm/4C750.s.o(.data);
        _4F850_s = .;
        build/asm/4F850.s.o(.data);
        _52990_s = .;
        build/asm/52990.s.o(.data);
        _52CD0_s = .;
        build/asm/52CD0.s.o(.data);
        _68A10_s = .;
        build/asm/68A10.s.o(.data);
        game_6EF50_c = .;
        build/src/game_6EF50.c.o(.data);
        _6F530_s = .;
        build/asm/6F530.s.o(.data);
        _6F5D0_s = .;
        build/asm/6F5D0.s.o(.data);
        _71AF0_s = .;
        build/asm/71AF0.s.o(.data);
        _74D80_s = .;
        build/asm/74D80.s.o(.data);
        _77080_s = .;
        build/asm/77080.s.o(.data);
        _79B70_s = .;
        build/asm/79B70.s.o(.data);
        os_osVirtualtoPhysical_c = .;
        build/src/os/osVirtualtoPhysical.c.o(.data);
        os_osSendMesg_c = .;
        build/src/os/osSendMesg.c.o(.data);
        os_osGetTime_c = .;
        build/src/os/osGetTime.c.o(.data);
        os_osSetTime_c = .;
        build/src/os/osSetTime.c.o(.data);
        _801B0_s = .;
        build/asm/801B0.s.o(.data);
        _80460_s = .;
        build/asm/80460.s.o(.data);
        _805A0_s = .;
        build/asm/805A0.s.o(.data);
        visetmode_s = .;
        build/asm/visetmode.s.o(.data);
        _80660_s = .;
        build/asm/80660.s.o(.data);
        _80820_s = .;
        build/asm/80820.s.o(.data);
        _80B00_s = .;
        build/asm/80B00.s.o(.data);
        _80B10_s = .;
        build/asm/80B10.s.o(.data);
        os_osSetEventMesg_c = .;
        build/src/os/osSetEventMesg.c.o(.data);
        _80BB0_s = .;
        build/asm/80BB0.s.o(.data);
        os_osCreateThread_c = .;
        build/src/os/osCreateThread.c.o(.data);
        _80D70_s = .;
        build/asm/80D70.s.o(.data);
        _80F70_s = .;
        build/asm/80F70.s.o(.data);
        viblack_s = .;
        build/asm/viblack.s.o(.data);
        setthreadpri_c = .;
        build/src/setthreadpri.c.o(.data);
        _815E0_s = .;
        build/asm/815E0.s.o(.data);
        sqrtf_s = .;
        build/asm/sqrtf.s.o(.data);
        game_81820_c = .;
        build/src/game_81820.c.o(.data);
        guOrtho_s = .;
        build/asm/guOrtho.s.o(.data);
        guTranslate_s = .;
        build/asm/guTranslate.s.o(.data);
        _81DE0_s = .;
        build/asm/81DE0.s.o(.data);
        _822A0_s = .;
        build/asm/822A0.s.o(.data);
        _82AD0_s = .;
        build/asm/82AD0.s.o(.data);
        _82C10_s = .;
        build/asm/82C10.s.o(.data);
        _82D50_s = .;
        build/asm/82D50.s.o(.data);
        _82DC0_s = .;
        build/asm/82DC0.s.o(.data);
        _830F0_s = .;
        build/asm/830F0.s.o(.data);
        _83270_s = .;
        build/asm/83270.s.o(.data);
        _83410_s = .;
        build/asm/83410.s.o(.data);
        _835C0_s = .;
        build/asm/835C0.s.o(.data);
        _840B0_s = .;
        build/asm/840B0.s.o(.data);
        _84620_s = .;
        build/asm/84620.s.o(.data);
        _84630_s = .;
        build/asm/84630.s.o(.data);
        _84760_s = .;
        build/asm/84760.s.o(.data);
        _84A10_s = .;
        build/asm/84A10.s.o(.data);
        _84AC0_s = .;
        build/asm/84AC0.s.o(.data);
        _84B70_s = .;
        build/asm/84B70.s.o(.data);
        _84C80_s = .;
        build/asm/84C80.s.o(.data);
        main_DATA_END = .;
        main_DATA_SIZE = ABSOLUTE(main_DATA_END - main_DATA_START);
        main_RODATA_START = .;
        build/asm/1000.s.o(.rodata);
        build/src/game_1C70.c.o(.rodata);
        build/asm/23E0.s.o(.rodata);
        build/asm/5480.s.o(.rodata);
        build/src/game_69D0.c.o(.rodata);
        build/src/game_BD30.c.o(.rodata);
        build/src/game_BF40.c.o(.rodata);
        build/src/game_C6C0.c.o(.rodata);
        build/src/game_24270.c.o(.rodata);
        build/src/game_24B00.c.o(.rodata);
        build/asm/2C670.s.o(.rodata);
        build/asm/34D50.s.o(.rodata);
        build/asm/355D0.s.o(.rodata);
        build/asm/39F00.s.o(.rodata);
        build/asm/3A580.s.o(.rodata);
        build/asm/3AC00.s.o(.rodata);
        build/src/game_42670.c.o(.rodata);
        build/asm/436A0.s.o(.rodata);
        build/asm/43DA0.s.o(.rodata);
        build/asm/4C750.s.o(.rodata);
        build/asm/4F850.s.o(.rodata);
        build/asm/52990.s.o(.rodata);
        build/asm/52CD0.s.o(.rodata);
        build/asm/68A10.s.o(.rodata);
        build/src/game_6EF50.c.o(.rodata);
        build/asm/6F530.s.o(.rodata);
        build/asm/6F5D0.s.o(.rodata);
        build/asm/71AF0.s.o(.rodata);
        build/asm/74D80.s.o(.rodata);
        build/asm/77080.s.o(.rodata);
        build/asm/79B70.s.o(.rodata);
        build/src/os/osVirtualtoPhysical.c.o(.rodata);
        build/src/os/osSendMesg.c.o(.rodata);
        build/src/os/osGetTime.c.o(.rodata);
        build/src/os/osSetTime.c.o(.rodata);
        build/asm/801B0.s.o(.rodata);
        build/asm/80460.s.o(.rodata);
        build/asm/805A0.s.o(.rodata);
        build/asm/visetmode.s.o(.rodata);
        build/asm/80660.s.o(.rodata);
        build/asm/80820.s.o(.rodata);
        build/asm/80B00.s.o(.rodata);
        build/asm/80B10.s.o(.rodata);
        build/src/os/osSetEventMesg.c.o(.rodata);
        build/asm/80BB0.s.o(.rodata);
        build/src/os/osCreateThread.c.o(.rodata);
        build/asm/80D70.s.o(.rodata);
        build/asm/80F70.s.o(.rodata);
        build/asm/viblack.s.o(.rodata);
        build/src/setthreadpri.c.o(.rodata);
        build/asm/815E0.s.o(.rodata);
        build/asm/sqrtf.s.o(.rodata);
        build/src/game_81820.c.o(.rodata);
        build/asm/guOrtho.s.o(.rodata);
        build/asm/guTranslate.s.o(.rodata);
        build/asm/81DE0.s.o(.rodata);
        build/asm/822A0.s.o(.rodata);
        build/asm/82AD0.s.o(.rodata);
        build/asm/82C10.s.o(.rodata);
        build/asm/82D50.s.o(.rodata);
        build/asm/82DC0.s.o(.rodata);
        build/asm/830F0.s.o(.rodata);
        build/asm/83270.s.o(.rodata);
        build/asm/83410.s.o(.rodata);
        build/asm/835C0.s.o(.rodata);
        build/asm/840B0.s.o(.rodata);
        build/asm/84620.s.o(.rodata);
        build/asm/84630.s.o(.rodata);
        build/asm/84760.s.o(.rodata);
        build/asm/84A10.s.o(.rodata);
        build/asm/84AC0.s.o(.rodata);
        build/asm/84B70.s.o(.rodata);
        build/asm/84C80.s.o(.rodata);
        main_RODATA_END = .;
        main_RODATA_SIZE = ABSOLUTE(main_RODATA_END - main_RODATA_START);
    }
    main_bss_VRAM = ADDR(.main_bss);
    .main_bss (NOLOAD) : SUBALIGN(16)
    {
        main_BSS_START = .;
        build/asm/1000.s.o(.bss);
        build/src/game_1C70.c.o(.bss);
        build/asm/23E0.s.o(.bss);
        build/asm/5480.s.o(.bss);
        build/src/game_69D0.c.o(.bss);
        build/src/game_BD30.c.o(.bss);
        build/src/game_BF40.c.o(.bss);
        build/src/game_C6C0.c.o(.bss);
        build/src/game_24270.c.o(.bss);
        build/src/game_24B00.c.o(.bss);
        build/asm/2C670.s.o(.bss);
        build/asm/34D50.s.o(.bss);
        build/asm/355D0.s.o(.bss);
        build/asm/39F00.s.o(.bss);
        build/asm/3A580.s.o(.bss);
        build/asm/3AC00.s.o(.bss);
        build/src/game_42670.c.o(.bss);
        build/asm/436A0.s.o(.bss);
        build/asm/43DA0.s.o(.bss);
        build/asm/4C750.s.o(.bss);
        build/asm/4F850.s.o(.bss);
        build/asm/52990.s.o(.bss);
        build/asm/52CD0.s.o(.bss);
        build/asm/68A10.s.o(.bss);
        build/src/game_6EF50.c.o(.bss);
        build/asm/6F530.s.o(.bss);
        build/asm/6F5D0.s.o(.bss);
        build/asm/71AF0.s.o(.bss);
        build/asm/74D80.s.o(.bss);
        build/asm/77080.s.o(.bss);
        build/asm/79B70.s.o(.bss);
        build/src/os/osVirtualtoPhysical.c.o(.bss);
        build/src/os/osSendMesg.c.o(.bss);
        build/src/os/osGetTime.c.o(.bss);
        build/src/os/osSetTime.c.o(.bss);
        build/asm/801B0.s.o(.bss);
        build/asm/80460.s.o(.bss);
        build/asm/805A0.s.o(.bss);
        build/asm/visetmode.s.o(.bss);
        build/asm/80660.s.o(.bss);
        build/asm/80820.s.o(.bss);
        build/asm/80B00.s.o(.bss);
        build/asm/80B10.s.o(.bss);
        build/src/os/osSetEventMesg.c.o(.bss);
        build/asm/80BB0.s.o(.bss);
        build/src/os/osCreateThread.c.o(.bss);
        build/asm/80D70.s.o(.bss);
        build/asm/80F70.s.o(.bss);
        build/asm/viblack.s.o(.bss);
        build/src/setthreadpri.c.o(.bss);
        build/asm/815E0.s.o(.bss);
        build/asm/sqrtf.s.o(.bss);
        build/src/game_81820.c.o(.bss);
        build/asm/guOrtho.s.o(.bss);
        build/asm/guTranslate.s.o(.bss);
        build/asm/81DE0.s.o(.bss);
        build/asm/822A0.s.o(.bss);
        build/asm/82AD0.s.o(.bss);
        build/asm/82C10.s.o(.bss);
        build/asm/82D50.s.o(.bss);
        build/asm/82DC0.s.o(.bss);
        build/asm/830F0.s.o(.bss);
        build/asm/83270.s.o(.bss);
        build/asm/83410.s.o(.bss);
        build/asm/835C0.s.o(.bss);
        build/asm/840B0.s.o(.bss);
        build/asm/84620.s.o(.bss);
        build/asm/84630.s.o(.bss);
        build/asm/84760.s.o(.bss);
        build/asm/84A10.s.o(.bss);
        build/asm/84AC0.s.o(.bss);
        build/asm/84B70.s.o(.bss);
        build/asm/84C80.s.o(.bss);
        main_BSS_END = .;
        main_BSS_SIZE = ABSOLUTE(main_BSS_END - main_BSS_START);
    }
    __romPos += SIZEOF(.main);
    __romPos = ALIGN(__romPos, 16);
    main_ROM_END = __romPos;
    main_VRAM_END = .;

    _8CDB0_ROM_START = __romPos;
    _8CDB0_VRAM = ADDR(._8CDB0);
    ._8CDB0 : AT(_8CDB0_ROM_START) SUBALIGN(16)
    {
        _8CDB0_DATA_START = .;
        _8CDB0_bin = .;
        build/assets/8CDB0.bin.o(.data);
        _8CDB0_DATA_END = .;
        _8CDB0_DATA_SIZE = ABSOLUTE(_8CDB0_DATA_END - _8CDB0_DATA_START);
    }
    __romPos += SIZEOF(._8CDB0);
    _8CDB0_ROM_END = __romPos;
    _8CDB0_VRAM_END = .;

    /DISCARD/ :
    {
        *(*);
    }
}
